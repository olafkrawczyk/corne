/*
 * Copyright (c) 2023 The ZMK Contributors
 *
 * SPDX-License-Identifier: MIT
 */

/ {
    chosen {
        zephyr,display = &nice_view;
    };
};

&nice_view_spi {
    cs-gpios = <&pro_micro 1 GPIO_ACTIVE_HIGH>;
    nice_view: nice_view@0 {
        compatible = "nordic,nrf-lcd";
        label = "NICE_VIEW";
        spi-max-frequency = <4000000>;
        reg = <0>;
        /* Vertical (rotated) logical resolution used by ZMK's nice!view screen */
        width = <68>;
        height = <160>;
        display-inversion;
        fsc-gpios = <&pro_micro 0 GPIO_ACTIVE_HIGH>;
    };
};
